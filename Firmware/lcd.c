#define F_CPU 11059200UL
#include<avr/pgmspace.h>
#include"lcd.h"
#include<util/delay.h>
#include <string.h>
#define ASCII_OFFSET 32

premission cursor_prem = disable;

void set_rs(unsigned short val)
{
	if(val) PORTB |= (1<<GLCD_RS);
	else PORTB &= ~(1<<GLCD_RS);
}

void set_rw(unsigned short val)
{
	if(val) PORTB |= (1<<GLCD_RW);
	else PORTB &= ~(1<<GLCD_RW);
}

void set_en(unsigned short val)
{
	if(val) PORTB |= (1<<GLCD_EN);
	else PORTB &= ~(1<<GLCD_EN);
}

void set_cs1(unsigned short val)
{
	if(val) PORTD |= (1<<GLCD_CS1);
	else PORTD &= ~(1<<GLCD_CS1);
}

void set_cs2(unsigned short val)
{
	if(val) PORTB |= (1<<GLCD_CS2);
	else PORTB &= ~(1<<GLCD_CS2);
}

void set_rst(unsigned short val)
{
	if(val) PORTB |= (1<<GLCD_RST);
	else PORTB &= ~(1<<GLCD_RST);
}

void enable_pulse(void)
{
	PORTB |= 0x02;
	_delay_us(5);
	PORTB &= ~0x02;
	_delay_us(5);
}




void GLCD_write(unsigned char b)
{
	set_rs(1);
	set_rw(0);
	GLCD_DATA_PORT = b;
	_delay_us(1);
	enable_pulse();
}

void GLCD_ON(void)
{
	set_cs1(0);
	set_cs2(0);
	set_rs(0);
	set_rw(0);
	GLCD_DATA_PORT = 0x3f;
	enable_pulse();
}

void Set_Start_Line(char line)
{
	set_cs1(0);
	set_cs2(0);
	set_rs(0);
	set_rw(0);
	GLCD_DATA_PORT=0xc0|line;
	enable_pulse();
}

void GOTO_col(unsigned char x)
{
	unsigned char col_data;
	set_rs(0);
	set_rw(0);
	if (x < 64)  //select left LCD part
	{
		set_cs1(0);
		set_cs2(1);
		col_data = x;
	}
	else		//select right LCD part
	{
		set_cs1(1);
		set_cs2(0);
		col_data = x-64;
	}
	col_data = (col_data | 0x40 ) & 0x7F;
	GLCD_DATA_PORT = col_data;
	enable_pulse();
}

void GOTO_page(unsigned short y)
{
	unsigned short pg_data;
	set_rs(0);
	set_rw(0);
	pg_data = (y | 0xB8) & 0xBF;
	GLCD_DATA_PORT = pg_data;
	enable_pulse();
}


void GOTO_xy(unsigned int x, unsigned int y)
{
	GOTO_col(x);
	GOTO_page(y);
}


void GLCD_cursor (struct GLCD_coordinates *xy)
{
	static int cursor_cnt;
	static unsigned char CURSOR_STATE = 0xFF;
	if (cursor_prem == enable)
	{
		unsigned int  x = (unsigned int) xy->x;
		unsigned short  y = (int) xy->y;
		CURSOR_STATE = ~CURSOR_STATE;
		GOTO_xy(x, y);

		cursor_cnt ++;
		if (cursor_cnt > 200)
		{
			GLCD_write(CURSOR_STATE);
			cursor_cnt = 0;
		}
	}

}

void GLCD_clr_p2p(char X1, char Y1, char X2, char Y2)
{

	for (int i = Y1; i<Y2; ++i)
	{
		if (i > Y1) {X1 = 0;}
		for(int j = X1; j<= X2; ++j)
		{
			GOTO_xy(j,i);
			GLCD_write(0x00);

		}

	}
}

void GLCD_clr_line(unsigned int ln)
{
	int i;
	GOTO_xy(0,ln);
	GOTO_xy(64,ln);
	set_cs1(0);
	for(i=0; i<65;i++)
	GLCD_write(0);
}

void GLCD_clr(void)
{
	unsigned char m;
	for(m=0; m<8; m++)
	GLCD_clr_line(m);

}

void GLCD_cursor_premission(premission prem)
{
	cursor_prem = prem;
}

void GLCD_remove_cursor(struct GLCD_coordinates *xy)
{
	GOTO_xy(xy->x, xy->y);
	GLCD_write(0x00);
}

void GLCD_move_cursor(struct GLCD_coordinates *xy)
{

    if (xy->x > 116)
	{
		xy->x = 1;
		xy->y ++;
	}
	else if (xy->x < 116)
	{
		xy->x += 6;
	}



}

unsigned char is_busy()
{
	unsigned char status = 0;
	set_en(0);
	_delay_us(1);
	set_rw(0);
	set_rs(0);
	_delay_us(1);
	set_en(1);
	_delay_us(5);

	set_en(0);
	_delay_us(5);

	set_en(1);
	_delay_us(1);

	status = GLCD_DATA_PORT_READING;
	set_en(0);
	_delay_us(1);

	return(status & 80);
}

unsigned char GLCD_read(int col)
{
	unsigned char read_data = 0;

	DDRA = 0x00;
	_delay_us(1);

	set_rw(1);
	set_rs(1);

	if (col < 64)
	{
		set_cs1(0);
		set_cs2(1);
	}
	else
	{
		set_cs1(1);
		set_cs2(0);
	}

	_delay_us(1);
	set_en(1);
	_delay_us(1);

	set_en(0);
	_delay_us(10);

	set_en(1);
	_delay_us(1);
	read_data = GLCD_DATA_PORT_READING;

	set_en(0);
	_delay_us(1);

	DDRA = 0xff;
	return read_data;

}

void point_at(int x, int y, int color)
{
	unsigned char Col_data = 0x00;
	GOTO_xy(x,(int)(y/8));

	switch (color)
	{
		case 0:
			Col_data = ~(1<<(y%8)) & GLCD_read(x); //light spot
			break;
		case 1:
			Col_data =  (1<<(y%8)) | (GLCD_read(x)); //Dark spot
			break;
	}

	GOTO_xy(x,(int)(y/8));
	GLCD_write(Col_data);
}

void h_line(unsigned int x, unsigned int y, unsigned short l, unsigned short c)
{
	unsigned int i;
	for (i=x;i<(l+x);i++)
	{
		point_at(i,y,c);
	}
}

void v_line(unsigned int x, unsigned int y, unsigned short l, unsigned short c)
{
	unsigned int i;
	for (i=y; i<(l+y);i++)
	{
		point_at(x,i,c);
	}
}



//WARNING: This Font is usable only with MikroE GLCD Lib.
//         X-GLCD Lib does not handle this font.

//Font Generated by MikroElektronika GLCD Font Creator 1.2.0.0
//MikroeElektronika 2011
//http://www.mikroe.com

//GLCD FontName : Terminal5x8
//GLCD FontSize : 5 x 8
const unsigned char init[] PROGMEM = {'I', 'n', 'i', 't', 'i', 'a', 'l', 'i', 's', 'a', 't', 'i', 'o', 'n', '.', '.', '.'};

const unsigned char Terminal5x8[] PROGMEM= {
	0x00, 0x00, 0x00, 0x00, 0x00,            // Code for char
	0x00, 0x06, 0x5F, 0x06, 0x00,            // Code for char !
	0x07, 0x03, 0x00, 0x07, 0x03,            // Code for char "
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	0x3C, 0x26, 0x23, 0x26, 0x3C             // Code for char 
};



void put_ch(char c, unsigned char x, unsigned char y)
{

	int start = (c-ASCII_OFFSET)*5;
	int stop = start + 5;
	int iter = 0;
	GOTO_xy(x,y);
	for(; start<stop; start++)
	{
		if (x+iter == 64) GOTO_xy(64, y);

		GLCD_write(pgm_read_byte(&Terminal5x8[start]));
		iter++;
	}

	iter = 0;


}
void put_init_message(unsigned char x, unsigned char y)
{
	int len = 17;//strlen((const char*)txt);
	xy.x = x;
	xy.y = y;

	GOTO_xy(xy.x, xy.y);

	for (int i = 0; i<len; i++)
	{
		put_ch(pgm_read_byte(&init[i]), xy.x, xy.y);
		//put_ch(txt[i], xy.x, xy.y);
		GLCD_move_cursor(&xy);
	}


}
